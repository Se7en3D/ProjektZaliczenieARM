/**
  ******************************************************************************
  * @file    dacConverter.c
  * @author  Daniel Dunak
  * @brief   Plik zródłowy odpowiedzialny za kontrolę nad przetwornikiem konwertującym bity na przebieg sinusoidalny
  *
  ******************************************************************************
  */
#include "stm32f4xx_hal.h"
#include <stdio.h>
#include "dacConverter.h"
#include "stateMachine.h"
#include "uartCom.h"

/**
 * @brief dacSin4700[] tablica zawerająca próbki sygnału sinusoidalnego dla czestotliwości 4700Hz
 */
volatile static const uint32_t dacSin4700[]={
		2048,
		2176,
		2303,
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		2048,
};
/**
 * @brief dacSin6700[] tablica zawerająca próbki sygnału sinusoidalnego dla czestotliwości 6700hz
 */
volatile static const uint32_t dacSin6700[]={
		2048,
		2230,
		2409,
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		2048,
};

/**
  * @brief	Inicjaliazcja struktury dacBaseStruct do wartości domyślnych
  * @param	hdac wskaźnik na strukturę DAC_HandleTypeDef
  * @retval None
  */
void dacConverterInit(DAC_HandleTypeDef *hdac){
	dacBaseStruct.hdac=hdac;
	dacBaseStruct.bitSendNumber=0;
	dacBaseStruct.sizeWaveF0=sizeof(dacSin4700)/sizeof(uint32_t);
	dacBaseStruct.sizeWaveF1=sizeof(dacSin6700)/sizeof(uint32_t);
}

/**
  * @brief	Przejście do konwersji kolejnego bitu
  * @retval None
  */
void dacNextBitConvert(){
	if(dacBaseStruct.status==DACCONVERTER_BUSY){
		if(dacBaseStruct.bitSendNumber>DACCINVERTER_MAX_BIT_TO_SEND){
			dacBaseStruct.status=DACCONVERTER_IDLE;
			if(uartComGetSizeDataInBuffor(&uartComBufforToCommunicationRx)==0){
				stateMachineChangeToReceving();
			}
			dacBaseStruct.bitSendNumber=0;
			return;
		}
		if((dacBaseStruct.dataToSend&(1<<dacBaseStruct.bitSendNumber))==0){
			HAL_DAC_Start_DMA(dacBaseStruct.hdac, DAC1_CHANNEL_1,(uint32_t*) dacSin4700, dacBaseStruct.sizeWaveF0, DAC_ALIGN_12B_R);
		}else{
			HAL_DAC_Start_DMA(dacBaseStruct.hdac, DAC1_CHANNEL_1,(uint32_t*) dacSin6700, dacBaseStruct.sizeWaveF1, DAC_ALIGN_12B_R);
		}

		dacBaseStruct.bitSendNumber++;
	}

}
/**
  * @brief	Przejście do konwersji kolejnego bitu
  * @param	data wartość 8 bitowa danych do wysłania
  * @retval None
  */
void dacConverterSetNewDataToSend(uint8_t data){
	if(dacBaseStruct.status==DACCONVERTER_IDLE){
		dacBaseStruct.dataToSend=data;
		if(dacBaseStruct.timeBreak>=DACCONVERTER_TIME_BREAK){
			dacBaseStruct.numberOfContinousConversions=0;
		}else{
			dacBaseStruct.numberOfContinousConversions++;
			if(dacBaseStruct.numberOfContinousConversions>=DACCONVERTER_MAX_BYTE_TO_SEND_WITHOUT_BREAK){
				dacBaseStruct.numberOfContinousConversions=0;
				dacBaseStruct.timeBreak=0;
				dacBaseStruct.status=DACCONVERTER_BREAK;
				return;
			}
		}
		dacBaseStruct.status=DACCONVERTER_BUSY;
		if(dacBaseStruct.bitSendNumber!=0){
			dacBaseStruct.bitSendNumber=0;
		}
		dacNextBitConvert();
	}
}

/**
  * @brief	Zarzadzanie zmienną timeBreak
  * @retval None
  */
void dacAddTimeBraek(){
	switch(dacBaseStruct.status){
		case DACCONVERTER_IDLE:
			dacBaseStruct.timeBreak++;
			break;
		case DACCONVERTER_BUSY:
			dacBaseStruct.timeBreak=0;
			break;
		case DACCONVERTER_BREAK:
			if(dacBaseStruct.timeBreak>=DACCONVERTER_TIME_BREAK){
				dacBaseStruct.timeBreak=0;
				dacBaseStruct.status=DACCONVERTER_BUSY;
				dacNextBitConvert();
			}else{
				dacBaseStruct.timeBreak++;
			}
			break;
	}
}
